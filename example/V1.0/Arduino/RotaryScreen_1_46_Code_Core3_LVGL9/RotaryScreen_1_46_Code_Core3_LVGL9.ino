/*---------------------------------------------------------------
 * Project configuration
 * Load the board definition and all display, touch, and UI objects.
 *--------------------------------------------------------------*/
// Reserved LovyanGFX option retained from the original project.
// #define LGFX_AUTOBUFFERmy_disp_flush
#include "RotaryScreen_1_46.h"

/*---------------------------------------------------------------
 * I2C and touch devices
 * Use the default Wire bus for touch and a second bus for board use.
 *--------------------------------------------------------------*/
// Auxiliary controller created on ESP32 I2C port 1.
TwoWire IIC = TwoWire(1); 
// Indirection retained so the touch bus pins can be assigned in setup().
static TwoWire* wi = &Wire;

// CST816T touch controller using Wire, interrupt GPIO 13, and reset GPIO 5.
cst816t touch = cst816t(Wire, 13, 5);
 
/*---------------------------------------------------------------
 * RTOS task handles
 * Keep references to the independent LED and encoder worker tasks.
 *--------------------------------------------------------------*/
TaskHandle_t ledTestTaskHandle = NULL;
TaskHandle_t encTaskHandle = NULL;

/*---------------------------------------------------------------
 * LVGL display state
 * Hold two PSRAM frame buffers and the registered display object.
 *--------------------------------------------------------------*/
static uint8_t *buf = NULL;
static uint8_t *buf1 = NULL;
static lv_display_t *display = NULL;

// Screen pointer queried before routing encoder and button actions.
lv_obj_t *current_screen = NULL;

// Enable this macro only when touch-coordinate logging is required.
//#define DEBUG_PRINT

// Selected main-menu item: 0 for Volume, 1 for Bulb, and 2 for Light.
int screen1_index = 1;

/*---------------------------------------------------------------
 * Encoder push-button interrupt
 * Capture short button events without performing UI work in the ISR.
 *--------------------------------------------------------------*/
/**
 * @brief Record an accepted encoder push-button edge.
 *
 * Applies a time-based debounce check, updates the shared press state,
 * and counts clicks for later single- or double-click classification.
 * UI transitions are deferred to encTask() because they are not safe
 * operations for an interrupt service routine.
 *
 * @note Parameters: None; the function is installed as a GPIO ISR.
 * @return Nothing.
 * @note Called on each falling edge detected on SWITCH_PIN.
 */
void IRAM_ATTR buttonISR() {
  static unsigned long lastInterruptTime = 0;
  unsigned long interruptTime = millis();

  // Ignore mechanical bounce until the active debounce interval expires.
  if (interruptTime - lastInterruptTime > debounceTime) {
    debounceTime = 40;
    if (digitalRead(SWITCH_PIN)) {
      pressFlag = false;
    } else {
      pressFlag = true;
      lastPressTime = interruptTime;
      clickCount++;
    }
  }
  lastInterruptTime = interruptTime;
} 

/*---------------------------------------------------------------
 * LVGL display output
 * Transfer rendered RGB565 regions to the LCD through SPI DMA.
 *--------------------------------------------------------------*/
/**
 * @brief Flush an LVGL render region to the ST77961 display.
 *
 * Ends any outstanding LovyanGFX write transaction, submits the requested
 * pixel rectangle through DMA, and releases LVGL to continue rendering.
 *
 * @param disp LVGL display that requested the transfer.
 * @param area Inclusive screen coordinates of the region to update.
 * @param px_map RGB565 pixel data generated by LVGL.
 * @return Nothing.
 * @note Called by LVGL whenever a rendered area must reach the panel.
 */
void my_disp_flush(lv_display_t *disp, const lv_area_t *area, uint8_t *px_map) {
  // DMA owns the transfer that follows, so close the earlier transaction.
  if (gfx.getStartCount() > 0) {
    gfx.endWrite();
  }
  gfx.pushImageDMA(area->x1, area->y1, area->x2 - area->x1 + 1, area->y2 - area->y1 + 1, (lgfx::rgb565_t *)px_map);

  lv_display_flush_ready(disp);
}

/*---------------------------------------------------------------
 * LVGL touch input
 * Translate CST816T samples into LVGL pointer states and coordinates.
 *--------------------------------------------------------------*/
/**
 * @brief Provide the latest touch sample to LVGL.
 *
 * Reports a pressed state and valid coordinates when the CST816T has new
 * data. A zero-zero sample is discarded because the controller may use it
 * as an invalid reading. Otherwise the input is reported as released.
 *
 * @param indev LVGL input device requesting data; unused by this driver.
 * @param data Destination for the pointer state and coordinates.
 * @return Nothing.
 * @note Called periodically by LVGL through its input-device handler.
 */
void my_touchpad_read(lv_indev_t *indev, lv_indev_data_t *data) {
  (void)indev;
  
  // The CST816T library supplies coordinates directly to the LVGL driver.
  //if ( gfx.getTouch( &touchX, &touchY ) ) {
  if(touch.available())
  {
    data->state = LV_INDEV_STATE_PRESSED;

    // Do not overwrite LVGL's last valid position with an invalid sample.
    if(touch.x == 0 && touch.y == 0)
      return ;
    data->point.x = touch.x;

    data->point.y = touch.y;
    
#ifdef DEBUG_PRINT
    Serial.print( "Data x " );
    Serial.println( data->point.x );
    Serial.print( "Data y " );
    Serial.println( data->point.y );
#endif
  }
  else
  {
    data->state = LV_INDEV_STATE_RELEASED;
  }
}

/*---------------------------------------------------------------
 * LCD backlight control
 * Start an 8-bit PWM channel at a visible mid-level brightness.
 *--------------------------------------------------------------*/
/**
 * @brief Initialize the LCD backlight PWM output.
 *
 * Attaches SCREEN_BACKLIGHT_PIN to the shared 5 kHz PWM configuration and
 * starts the display at 50 percent brightness.
 *
 * @note Parameters: None.
 * @return Nothing.
 * @note Called once near the end of setup(), after the UI is initialized.
 */
void initBacklight() {
  ledcAttach(SCREEN_BACKLIGHT_PIN, pwmFreq, pwmResolution);
  ledcWrite(SCREEN_BACKLIGHT_PIN, (50 * 255) / 100);
}

/*---------------------------------------------------------------
 * Encoder button actions
 * Enter the selected detail page or return to the main menu.
 *--------------------------------------------------------------*/
/**
 * @brief Open the detail page selected on the main menu.
 *
 * Maps menu indexes 0, 1, and 2 to the Volume, Bulb, and Light screens.
 * The action is ignored when another screen is already active.
 *
 * @note Parameters: None.
 * @return Nothing.
 * @note Called by encTask() after a single click is confirmed.
 */
void performClickAction()
{
  current_screen = lv_screen_active();
  if(current_screen == ui_Screen1)
  {
    if(current_screen == ui_Screen1)
    {
      if(screen1_index == 0)
      {
        _ui_screen_change(&ui_Screen2, LV_SCR_LOAD_ANIM_FADE_ON, 200 ,0, &ui_Screen2_screen_init);
      }
      else if(screen1_index == 1)
      {
        _ui_screen_change(&ui_Screen3, LV_SCR_LOAD_ANIM_FADE_ON, 200 ,0, &ui_Screen3_screen_init);
      }
      else if(screen1_index == 2)
      {
        _ui_screen_change(&ui_Screen4, LV_SCR_LOAD_ANIM_FADE_ON, 200 ,0, &ui_Screen4_screen_init);
      }
    }
  }
}

/**
 * @brief Return from a detail page to the main menu.
 *
 * Accepts a double click only on the Volume, Bulb, or Light screen and
 * applies the same short fade transition used by touch navigation.
 *
 * @note Parameters: None.
 * @return Nothing.
 * @note Called by encTask() as soon as two clicks are detected.
 */
void performDoubleClickAction()
{
  current_screen = lv_screen_active();
  if(current_screen == ui_Screen2 || current_screen == ui_Screen3 || current_screen == ui_Screen4)
  {

    _ui_screen_change(&ui_Screen1, LV_SCR_LOAD_ANIM_FADE_ON, 200 ,0, &ui_Screen1_screen_init);
      
  }
}

/*---------------------------------------------------------------
 * Arc value-change callbacks
 * Keep percentage labels and physical PWM outputs synchronized with UI.
 *--------------------------------------------------------------*/
/**
 * @brief Update the displayed Volume percentage.
 *
 * Reads the changed arc value and formats a fixed-width percentage label.
 * This screen is a UI demonstration and does not control audio hardware.
 *
 * @param e LVGL value-change event generated by the Volume arc.
 * @return Nothing.
 * @note Called by LVGL when ui_VolumeArc reports LV_EVENT_VALUE_CHANGED.
 */
static void volume_arc_event_cb(lv_event_t *e)
{
    lv_obj_t *arc = lv_event_get_target_obj(e);
    int value = lv_arc_get_value(arc);
    
    // Preserve label alignment by adding a leading space below 100 percent.
    char volText[8];
    if (value == 100) {
        snprintf(volText, sizeof(volText), "%d%%", value);
    } else {
        snprintf(volText, sizeof(volText), " %d%%", value);
    }
    lv_label_set_text(ui_VolNum, volText);
}

/**
 * @brief Update the Bulb percentage and its PWM duty cycle.
 *
 * Converts the arc's 0-to-100 value into the 0-to-255 range required by
 * the 8-bit PWM output on BULB_LED_PIN.
 *
 * @param e LVGL value-change event generated by the Bulb arc.
 * @return Nothing.
 * @note Called by LVGL when ui_BulbArc reports LV_EVENT_VALUE_CHANGED.
 */
static void bulb_arc_event_cb(lv_event_t *e)
{
    lv_obj_t *arc = lv_event_get_target_obj(e);
    int value = lv_arc_get_value(arc);
    
    // Preserve label alignment by adding a leading space below 100 percent.
    char bulbText[8];
    if (value == 100) {
        snprintf(bulbText, sizeof(bulbText), "%d%%", value);
    } else {
        snprintf(bulbText, sizeof(bulbText), " %d%%", value);
    }
    lv_label_set_text(ui_BulbNum, bulbText);
    
    // Scale the UI percentage to the configured 8-bit PWM range.
    int pwm_value = (value * 255) / 100;
    ledcWrite(BULB_LED_PIN, pwm_value);
}

/**
 * @brief Update the Light percentage and LCD backlight level.
 *
 * Converts the arc's 0-to-100 value into the 0-to-255 range required by
 * the 8-bit PWM output on SCREEN_BACKLIGHT_PIN.
 *
 * @param e LVGL value-change event generated by the Light arc.
 * @return Nothing.
 * @note Called by LVGL when ui_LightArc reports LV_EVENT_VALUE_CHANGED.
 */
static void light_arc_event_cb(lv_event_t *e)
{
    lv_obj_t *arc = lv_event_get_target_obj(e);
    int value = lv_arc_get_value(arc);
    
    // Preserve label alignment by adding a leading space below 100 percent.
    char lightText[8];
    if (value == 100) {
        snprintf(lightText, sizeof(lightText), "%d%%", value);
    } else {
        snprintf(lightText, sizeof(lightText), " %d%%", value);
    }
    lv_label_set_text(ui_LightNum, lightText);
    
    // A value of zero leaves the UI running but turns the backlight off.
    int pwm_value = (value * 255) / 100;
    ledcWrite(SCREEN_BACKLIGHT_PIN, pwm_value);
}

/*---------------------------------------------------------------
 * Rotary encoder worker task
 * Decode rotation, adjust the active page, and classify button clicks.
 *--------------------------------------------------------------*/
/**
 * @brief Process rotary encoder and push-button input continuously.
 *
 * Decodes the two encoder phases, changes the active arc in five-percent
 * steps, updates physical PWM outputs, routes main-menu selection changes,
 * and classifies button input as a single or double click.
 *
 * @param pvParameters Optional FreeRTOS task context; unused.
 * @return Nothing; this task runs indefinitely.
 * @note Created on Core 0 near the end of setup().
 */
void encTask(void *pvParameters) {
  while (1) {
    // A phase-A transition marks one encoder event; phase B determines
    // which direction produced that transition.
    currentStateCLK = digitalRead(ENCODER_A_PIN);

    // Process only a changed phase-A sample to avoid repeated counts while
    // the encoder remains at one logic level.
    if (currentStateCLK != lastStateCLK) {// && currentStateCLK == 1) {

      current_screen = lv_screen_active();

      // Different phase levels select the branch that increases the active
      // value in this board's mechanical orientation.
      if (digitalRead(ENCODER_B_PIN) != currentStateCLK) {
        // Reject an implausibly large counter discontinuity before it can
        // be interpreted as a valid UI action.
        if (abs(last_counter - counter) > 200) {
          continue;
        }
        position_tmp = 1;

        if (current_screen == ui_Screen2) {
          int currentVol = lv_arc_get_value(ui_VolumeArc);
          Serial.printf(" ++ currentVol = %d\n", currentVol);
          int newVol = (currentVol + 5) > 100 ? 100 : currentVol + 5;
          Serial.printf(" ++ END currentVol = %d\n", newVol);
          lv_arc_set_value(ui_VolumeArc, newVol);

          char volumeText[8];
          if (newVol == 100) {
            snprintf(volumeText, sizeof(volumeText), "%d%%", newVol);
            lv_label_set_text(ui_VolNum, volumeText);
          } else {
            snprintf(volumeText, sizeof(volumeText), " %d%%", newVol);
            lv_label_set_text(ui_VolNum, volumeText);
          }

        } else if (current_screen == ui_Screen3) {
          int currentBulb = lv_arc_get_value(ui_BulbArc);
          Serial.printf(" ++ currentBulb = %d\n", currentBulb);
          int newBulb = (currentBulb + 5) > 100 ? 100 : currentBulb + 5;
          Serial.printf(" ++ END currentBulb = %d\n", newBulb);
          lv_arc_set_value(ui_BulbArc, newBulb);

          char BulbText[8];
          if (newBulb == 100) {
            snprintf(BulbText, sizeof(BulbText), "%d%%", newBulb);
            lv_label_set_text(ui_BulbNum, BulbText);
          } else {
            snprintf(BulbText, sizeof(BulbText), " %d%%", newBulb);
            lv_label_set_text(ui_BulbNum, BulbText);
          }
          // Keep the board's bulb PWM output aligned with the UI value.
          int pwm_value = (newBulb * 255) / 100;
          ledcWrite(BULB_LED_PIN, pwm_value);

        } else if (current_screen == ui_Screen4) {
          int currentLight = lv_arc_get_value(ui_LightArc);
          Serial.printf(" ++ currentLight = %d\n", currentLight);
          int newLight = (currentLight + 5) > 100 ? 100 : currentLight + 5;
          Serial.printf(" ++ END currentLight = %d\n", newLight);
          lv_arc_set_value(ui_LightArc, newLight);
          
          char LightText[8];
          if (newLight == 100) {
            snprintf(LightText, sizeof(LightText), "%d%%", newLight);
            lv_label_set_text(ui_LightNum, LightText);
          } else {
            snprintf(LightText, sizeof(LightText), " %d%%", newLight);
            lv_label_set_text(ui_LightNum, LightText);
          }
          int pwm_value = (newLight * 255) / 100;
          ledcWrite(SCREEN_BACKLIGHT_PIN, pwm_value);
        }

        counter++;
        currentDir = "CCW";
      } else {
        // Discard the first transition in this branch so startup state does
        // not create an unintended decrement.
        if (one_test == false) 
        {
          one_test = true;
          continue;
        }

        if (current_screen == ui_Screen2) {
          int currentVol = lv_arc_get_value(ui_VolumeArc);
          Serial.printf(" -- currentVol = %d\n", currentVol);
          int newVol = (currentVol - 5) < 0 ? 0 : currentVol - 5;
          Serial.printf(" -- END currentVol = %d\n", newVol);
          lv_arc_set_value(ui_VolumeArc, newVol);

          char volumeText[8];
          if (newVol == 100) {
            snprintf(volumeText, sizeof(volumeText), "%d%%", newVol);
            lv_label_set_text(ui_VolNum, volumeText);
          } else {
            snprintf(volumeText, sizeof(volumeText), " %d%%", newVol);
            lv_label_set_text(ui_VolNum, volumeText);
          }

        } else if (current_screen == ui_Screen3) {
          int currentBulb = lv_arc_get_value(ui_BulbArc);
          Serial.printf(" -- currentBulb = %d\n", currentBulb);
          int newBulb = (currentBulb - 5) < 0 ? 0 : currentBulb - 5;
          Serial.printf(" -- END currentBulb = %d\n", newBulb);
          lv_arc_set_value(ui_BulbArc, newBulb);

          char BulbText[8];
          if (newBulb == 100) {
            snprintf(BulbText, sizeof(BulbText), "%d%%", newBulb);
            lv_label_set_text(ui_BulbNum, BulbText);
          } else {
            snprintf(BulbText, sizeof(BulbText), " %d%%", newBulb);
            lv_label_set_text(ui_BulbNum, BulbText);
          }
          // Keep the board's bulb PWM output aligned with the UI value.
          int pwm_value = (newBulb * 255) / 100;
          ledcWrite(BULB_LED_PIN, pwm_value);

        } else if (current_screen == ui_Screen4) {
          int currentLight = lv_arc_get_value(ui_LightArc);
          Serial.printf(" -- currentLight = %d\n", currentLight);
          int newLight = (currentLight - 5) < 0 ? 0 : currentLight - 5;
          Serial.printf(" -- END currentLight = %d\n", newLight);
          lv_arc_set_value(ui_LightArc, newLight);

          char LightText[8];
          if (newLight == 100) {
            snprintf(LightText, sizeof(LightText), "%d%%", newLight);
            lv_label_set_text(ui_LightNum, LightText);
          } else {
            snprintf(LightText, sizeof(LightText), " %d%%", newLight);
            lv_label_set_text(ui_LightNum, LightText);
          }
          int pwm_value = (newLight * 255) / 100;
          ledcWrite(SCREEN_BACKLIGHT_PIN, pwm_value);
        }

        position_tmp = 0;
        counter--;
        currentDir = "CW";
      }

      Serial.print("Direction: ");
      Serial.print(currentDir);
      Serial.print(" | Counter: ");
      Serial.println(counter);
      last_counter = counter;

      processEncoder();

    }
    
    // Save phase A so an unchanged sample is ignored on the next pass.
    lastStateCLK = currentStateCLK;

    // A single click is accepted only after the double-click window closes;
    // the second click can therefore override it with a return action.
    if (clickCount == 1 && millis() - lastPressTime > doubleClickTime) {
      Serial.println("click ");
      Serial.printf("clickCount Value:");
      Serial.println(clickCount);
      performClickAction();
      debounceTime = 40;
      clickCount = 0; 
    }
    else if (clickCount == 2) {
      Serial.println("double click");
      Serial.printf("clickCount Value:");
      Serial.println(clickCount);
      performDoubleClickAction();
      debounceTime = 160;
      clickCount = 0; 
    }

    // More than two counts indicate bounce or an unsupported click sequence.
    if (clickCount > 2) {
      clickCount = 0;
    }
    // A short task delay provides regular polling without monopolizing Core 0.
    vTaskDelay(pdMS_TO_TICKS(5));
  }
}

/*---------------------------------------------------------------
 * Main-menu selection
 * Constrain the selected item and update its visual emphasis.
 *--------------------------------------------------------------*/
/**
 * @brief Apply the latest encoder direction to the main-menu index.
 *
 * Changes the selection only while Screen1 is active, clamps movement at
 * the first and last items, then asks updataScreen() to refresh the icons.
 *
 * @note Parameters: None.
 * @return Nothing.
 * @note Called by encTask() after each accepted encoder transition.
 */
void processEncoder()
{
  current_screen = lv_screen_active();

  if(current_screen == ui_Screen1)
  {
    if(position_tmp == 1)
    {
      if(screen1_index < 2)
      {
        screen1_index++;
      }

      Serial.printf("cur_index : %d\n", screen1_index);
    }
    else if(position_tmp == 0)
    {
      if(screen1_index > 0)
      {
        screen1_index--;
      }

      Serial.printf("cur_index : %d\n", screen1_index);
    }
    updataScreen(screen1_index);
    position_tmp = -1;
  }
}

/**
 * @brief Update the main-menu layout for a selected index.
 *
 * Hides all colored variants before showing and positioning the blue
 * selected item and the white neighboring items. The function name is
 * retained from the original project to avoid changing program symbols.
 *
 * @param index Requested menu item from 0 through 2.
 * @return Nothing.
 * @note Called by processEncoder() whenever the main-menu selection changes.
 */
void updataScreen(int index)
{
  // Defensive clamping prevents an invalid index from reaching the switch.
  if(index < 0)
  {
    index = 0;
  }
  else if (index > 2)
  {
    index = 2;
  }

  Serial.printf("cur_index :%d\n", screen1_index);

  lv_obj_add_flag(ui_volumeBlue,  LV_OBJ_FLAG_HIDDEN);
  lv_obj_add_flag(ui_volumeWhite, LV_OBJ_FLAG_HIDDEN);
  lv_obj_add_flag(ui_BulbBlue,    LV_OBJ_FLAG_HIDDEN);
  lv_obj_add_flag(ui_BulbWhite,   LV_OBJ_FLAG_HIDDEN);
  lv_obj_add_flag(ui_LightBlue,   LV_OBJ_FLAG_HIDDEN);
  lv_obj_add_flag(ui_LightWhite,  LV_OBJ_FLAG_HIDDEN);

  // Each branch arranges one selected item at the center and keeps only
  // the relevant neighboring white icons visible.
  switch(index)
  {
    case 0:
      // Select Volume and place it in the center.
      lv_obj_remove_flag(ui_volumeBlue, LV_OBJ_FLAG_HIDDEN);
      lv_obj_remove_flag(ui_volumeTextBlue, LV_OBJ_FLAG_HIDDEN);
      lv_obj_add_flag(ui_volumeWhite, LV_OBJ_FLAG_HIDDEN);
      lv_obj_add_flag(ui_volumeTextWhite, LV_OBJ_FLAG_HIDDEN);
      lv_obj_set_x(ui_volumeBlue, 0);
      lv_obj_set_x(ui_volumeTextBlue, 0);
      lv_obj_set_x(ui_volumeWhite, 0);
      lv_obj_set_x(ui_volumeTextWhite, 0);

      // Keep Bulb visible as the next white item.
      lv_obj_remove_flag(ui_BulbWhite, LV_OBJ_FLAG_HIDDEN);
      lv_obj_remove_flag(ui_BulbTextWhite, LV_OBJ_FLAG_HIDDEN);
      lv_obj_add_flag(ui_BulbBlue, LV_OBJ_FLAG_HIDDEN);
      lv_obj_add_flag(ui_BulbTextBlue, LV_OBJ_FLAG_HIDDEN);
      lv_obj_set_x(ui_BulbWhite, 110);
      lv_obj_set_x(ui_BulbTextWhite, 110);
      lv_obj_set_x(ui_BulbBlue, 110);
      lv_obj_set_x(ui_BulbTextBlue, 110);

      // Light is outside the visible selection window at this edge.
      lv_obj_add_flag(ui_LightWhite, LV_OBJ_FLAG_HIDDEN);
      lv_obj_add_flag(ui_LightTextWhite, LV_OBJ_FLAG_HIDDEN);

      break;
    case 1:
      // Keep Volume visible as the previous white item.
      lv_obj_remove_flag(ui_volumeWhite, LV_OBJ_FLAG_HIDDEN);
      lv_obj_remove_flag(ui_volumeTextWhite, LV_OBJ_FLAG_HIDDEN);
      lv_obj_add_flag(ui_volumeBlue, LV_OBJ_FLAG_HIDDEN);
      lv_obj_add_flag(ui_volumeTextBlue, LV_OBJ_FLAG_HIDDEN);
      lv_obj_set_x(ui_volumeBlue, -110);
      lv_obj_set_x(ui_volumeTextBlue, -110);
      lv_obj_set_x(ui_volumeWhite, -110);
      lv_obj_set_x(ui_volumeTextWhite, -110);
      // Select Bulb and place it in the center.
      lv_obj_remove_flag(ui_BulbBlue, LV_OBJ_FLAG_HIDDEN);
      lv_obj_remove_flag(ui_BulbTextBlue, LV_OBJ_FLAG_HIDDEN);
      lv_obj_add_flag(ui_BulbWhite, LV_OBJ_FLAG_HIDDEN);
      lv_obj_add_flag(ui_BulbTextWhite, LV_OBJ_FLAG_HIDDEN);
      lv_obj_set_x(ui_BulbWhite, 0);
      lv_obj_set_x(ui_BulbTextWhite, 0);
      lv_obj_set_x(ui_BulbBlue, 0);
      lv_obj_set_x(ui_BulbTextBlue, 0);

      // Keep Light visible as the next white item.
      lv_obj_remove_flag(ui_LightWhite, LV_OBJ_FLAG_HIDDEN);
      lv_obj_remove_flag(ui_LightTextWhite, LV_OBJ_FLAG_HIDDEN);
      lv_obj_add_flag(ui_LightBlue, LV_OBJ_FLAG_HIDDEN);
      lv_obj_add_flag(ui_LightTextBlue, LV_OBJ_FLAG_HIDDEN);
      lv_obj_set_x(ui_LightBlue, 110);
      lv_obj_set_x(ui_LightTextBlue, 110);
      lv_obj_set_x(ui_LightWhite, 110);
      lv_obj_set_x(ui_LightTextWhite, 110);
      break;
    case 2:
      // Volume is outside the visible selection window at this edge.
      lv_obj_add_flag(ui_volumeWhite, LV_OBJ_FLAG_HIDDEN);
      lv_obj_add_flag(ui_volumeTextWhite, LV_OBJ_FLAG_HIDDEN);
      lv_obj_add_flag(ui_volumeBlue, LV_OBJ_FLAG_HIDDEN);
      lv_obj_add_flag(ui_volumeTextBlue, LV_OBJ_FLAG_HIDDEN);

      // Keep Bulb visible as the previous white item.
      lv_obj_remove_flag(ui_BulbWhite, LV_OBJ_FLAG_HIDDEN);
      lv_obj_remove_flag(ui_BulbTextWhite, LV_OBJ_FLAG_HIDDEN);
      lv_obj_add_flag(ui_BulbBlue, LV_OBJ_FLAG_HIDDEN);
      lv_obj_add_flag(ui_BulbTextBlue, LV_OBJ_FLAG_HIDDEN);
      lv_obj_set_x(ui_BulbWhite, -110);
      lv_obj_set_x(ui_BulbTextWhite, -110);
      lv_obj_set_x(ui_BulbBlue, -110);
      lv_obj_set_x(ui_BulbTextBlue, -110);

      // Select Light and place it in the center.
      lv_obj_remove_flag(ui_LightBlue, LV_OBJ_FLAG_HIDDEN);
      lv_obj_remove_flag(ui_LightTextBlue, LV_OBJ_FLAG_HIDDEN);
      lv_obj_add_flag(ui_LightWhite, LV_OBJ_FLAG_HIDDEN);
      lv_obj_add_flag(ui_LightTextWhite, LV_OBJ_FLAG_HIDDEN);
      lv_obj_set_x(ui_LightBlue, 0);
      lv_obj_set_x(ui_LightTextBlue, 0);
      lv_obj_set_x(ui_LightWhite, 0);
      lv_obj_set_x(ui_LightTextWhite, 0); 

      break;
  }
}

/*---------------------------------------------------------------
 * NeoPixel demonstration task
 * Cycle through flowing, flashing, and breathing LED patterns.
 *--------------------------------------------------------------*/
/**
 * @brief Run the addressable LED demonstration sequence.
 *
 * Repeats five visual patterns while isLed remains true. Each blocking
 * pause uses the FreeRTOS scheduler so encoder and LVGL work can continue.
 * If isLed becomes false, the task clears the strip and suspends itself.
 *
 * @param pvParameters Optional FreeRTOS task context; unused.
 * @return Nothing; this task runs indefinitely unless suspended.
 * @note Created on Core 0 near the end of setup().
 */
void ledTestTask(void *pvParameters) {
  while (1) {
    // Begin every full sequence from a known, dark LED state.
    led.clear();
    led.show();

    // Pattern 1: move one white pixel around the ring for five rounds.
    while ((isLed) && (ledCount++ < 5)) {
      for (int i = 0; isLed && i < 8; i++) {
        led.setPixelColor(i, led.Color(255, 255, 255));
        led.show();
        vTaskDelay(pdMS_TO_TICKS(250));
        led.clear();
        led.show();
      }
    }
    ledCount = 0;

    // Pattern 2: flash all eight assigned colors at a fast rate.
    for (int i = 0; isLed && i < 5; i++) {
      led.setPixelColor(0, led.Color(255, 0, 0));
      led.setPixelColor(1, led.Color(0, 255, 0));
      led.setPixelColor(2, led.Color(0, 0, 255));
      led.setPixelColor(3, led.Color(255, 255, 0));
      led.setPixelColor(4, led.Color(130, 0, 255));
      led.setPixelColor(5, led.Color(0, 130, 255));
      led.setPixelColor(6, led.Color(255, 130, 0));
      led.setPixelColor(7, led.Color(255, 0, 130));
      
      led.show();
      vTaskDelay(pdMS_TO_TICKS(100));
      led.clear();
      led.show();
      vTaskDelay(pdMS_TO_TICKS(100));
    }

    // Pattern 3: move a different fixed color through each LED position.
    while (isLed && ledCount < 5) {
      for (int i = 0; isLed && i < 8; i++) {
        led.clear();
        switch (i) {
          case 0: led.setPixelColor(i, led.Color(255, 0, 0));   break;
          case 1: led.setPixelColor(i, led.Color(0, 255, 0));   break;
          case 2: led.setPixelColor(i, led.Color(0, 0, 255));   break;
          case 3: led.setPixelColor(i, led.Color(255, 255, 0)); break;
          case 4: led.setPixelColor(i, led.Color(130, 0, 255)); break;
          case 5: led.setPixelColor(i, led.Color(0, 130, 255)); break;
          case 6: led.setPixelColor(i, led.Color(255, 130, 0)); break;
          case 7: led.setPixelColor(i, led.Color(255, 0, 130)); break;
        }
        led.show();
        vTaskDelay(pdMS_TO_TICKS(250));
      }
      ledCount++;
    }
    ledCount = 0;

    // Pattern 4: flash the same color set at a slower rate.
    for (int i = 0; isLed && i < 5; i++) {
      led.setPixelColor(0, led.Color(255, 0, 0));
      led.setPixelColor(1, led.Color(0, 255, 0));
      led.setPixelColor(2, led.Color(0, 0, 255));
      led.setPixelColor(3, led.Color(255, 255, 0));
      led.setPixelColor(4, led.Color(130, 0, 255));
      led.setPixelColor(5, led.Color(0, 130, 255));
      led.setPixelColor(6, led.Color(255, 130, 0));
      led.setPixelColor(7, led.Color(255, 0, 130));
      led.show();
      vTaskDelay(pdMS_TO_TICKS(250));
      led.clear();
      led.show();
      vTaskDelay(pdMS_TO_TICKS(250));
    }

    // Pattern 5: preserve each pixel's color while fading global brightness
    // up and down. The original loop count is retained unchanged.
    led.setPixelColor(0, led.Color(255, 0, 0));
    led.setPixelColor(1, led.Color(0, 255, 0));
    led.setPixelColor(2, led.Color(0, 0, 255));
    led.setPixelColor(3, led.Color(255, 255, 0));
    led.setPixelColor(4, led.Color(130, 0, 255));
    led.setPixelColor(5, led.Color(0, 130, 255));
    led.setPixelColor(6, led.Color(255, 130, 0));
    led.setPixelColor(7, led.Color(255, 0, 130));
    while ((isLed) && (ledCount++ < 10)) {
      for (ledBrightness = 0; isLed && ledBrightness <= 25; ledBrightness++) {
        led.setBrightness(ledBrightness);
        led.setPixelColor(0, led.Color(255, 0, 0));
        led.setPixelColor(1, led.Color(0, 255, 0));
        led.setPixelColor(2, led.Color(0, 0, 255));
        led.setPixelColor(3, led.Color(255, 255, 0));
        led.setPixelColor(4, led.Color(130, 0, 255));
        led.setPixelColor(5, led.Color(0, 130, 255));
        led.setPixelColor(6, led.Color(255, 130, 0));
        led.setPixelColor(7, led.Color(255, 0, 130));
        led.show();
        vTaskDelay(pdMS_TO_TICKS(50));
      }
      for (; isLed && ledBrightness >= 0; ledBrightness--) {
        led.setBrightness(ledBrightness);
        led.show();
        vTaskDelay(pdMS_TO_TICKS(50));
      }
      ledCount++;
    }

    ledCount = 0;
    ledBrightness = 0;
    led.setBrightness(25);
    led.clear();
    led.show();

    // A stop request leaves the hardware dark before suspending this task.
    if (!isLed) {
      ledCount = 0;
      ledBrightness = 0;
      led.setBrightness(25);
      led.clear();
      led.show();
      vTaskSuspend(NULL);
    }

    vTaskDelay(pdMS_TO_TICKS(5));
  }
}

/*---------------------------------------------------------------
 * Arduino initialization
 * Power the board peripherals and connect them to the LVGL application.
 *--------------------------------------------------------------*/
/**
 * @brief Initialize all hardware, graphics, UI, and worker tasks.
 *
 * Starts serial diagnostics, sequences LCD power and reset, initializes
 * I2C, SPI DMA, CST816T, LVGL buffers and callbacks, loads the generated
 * UI, configures PWM outputs, and creates the two Core 0 worker tasks.
 *
 * @note Parameters: None; this is an Arduino lifecycle function.
 * @return Nothing.
 * @note Called once by the Arduino framework after reset.
 */
void setup() {
  // Serial output is used for allocation failures and encoder diagnostics.
  Serial.begin(115200);
  while(!Serial);

  // Apply the LCD controller's required reset pulse after power becomes valid.
  pinMode(14, OUTPUT);
  digitalWrite(14, HIGH);
  delay(10);
  digitalWrite(14, LOW);
  delay(10);
  digitalWrite(14, HIGH);

  // The touch controller and auxiliary board bus use separate I2C ports.
  wi->setPins(6,7);
  wi->begin();
  IIC.begin(I2C_SDA_PIN, I2C_SCL_PIN);

  // The board's power indicator is wired active-low.
  pinMode(POWER_LIGHT_PIN, OUTPUT);        
  digitalWrite(POWER_LIGHT_PIN, LOW);

  // Reserved outputs retained from the original hardware bring-up.
  // pinMode(4 , OUTPUT);        
  // pinMode(12, OUTPUT);            

  // Both rails must be enabled before the LCD can accept display data.
  pinMode(1, OUTPUT);   
  digitalWrite(1, HIGH);
  pinMode(2, OUTPUT);    
  digitalWrite(2, HIGH); 

  // Enable power for the addressable LED ring.
  pinMode(17, OUTPUT);
  digitalWrite(17, HIGH);

  // Keep the ISR minimal; the encoder task performs click classification.
  attachInterrupt(digitalPinToInterrupt(SWITCH_PIN), buttonISR, FALLING);

  // Retained timing hook from the original board initialization.
  //delay(100);

  // Prepare the ST77961 and DMA engine before LVGL begins rendering.
  gfx.init();
  gfx.initDMA();  
  gfx.startWrite();
  gfx.setColor(0, 0, 0);
  gfx.setTextSize(2);
  gfx.fillScreen(TFT_BLACK);
  
  // Start the touch controller before registering it as an LVGL input.
  touch.begin(mode_touch);

  // Use Arduino's millisecond counter as the LVGL system tick source.
  lv_init();
  lv_tick_set_cb(millis);

  // RGB565 requires two bytes per pixel. Two full-screen buffers are placed
  // in PSRAM so rendering does not exhaust internal memory.
  size_t buffer_size = screenWidth * screenHeight * 2;
  buf = (uint8_t *)heap_caps_malloc(buffer_size, MALLOC_CAP_SPIRAM | MALLOC_CAP_8BIT);
  buf1 = (uint8_t *)heap_caps_malloc(buffer_size, MALLOC_CAP_SPIRAM | MALLOC_CAP_8BIT);
  if (!buf)
    Serial.println("Failed to allocate for LVGL buf!");
  if (!buf1)
    Serial.println("Failed to allocate for LVGL buf1!");

  // Bind the RGB565 buffers and DMA flush function to the LVGL display.
  display = lv_display_create(screenWidth, screenHeight);
  lv_display_set_color_format(display, LV_COLOR_FORMAT_RGB565);
  lv_display_set_flush_cb(display, my_disp_flush);
  lv_display_set_buffers(display, buf, buf1, buffer_size, LV_DISPLAY_RENDER_MODE_PARTIAL);

  // Register the CST816T as an LVGL pointer device for arcs and buttons.
  lv_indev_t *indev = lv_indev_create();
  lv_indev_set_type(indev, LV_INDEV_TYPE_POINTER);
  lv_indev_set_read_cb(indev, my_touchpad_read);
  delay(100);

  // Create the generated startup, menu, and three detail screens.
  ui_init();

  // All three controls share a percentage range for consistent interaction.
  lv_arc_set_range(ui_VolumeArc,  0, 100);
  lv_arc_set_range(ui_BulbArc  ,  0, 100);
  lv_arc_set_range(ui_LightArc ,  0, 100);

  // Begin each detail page at the midpoint shown by its percentage label.
  lv_arc_set_value(ui_VolumeArc, 50);
  lv_arc_set_value(ui_BulbArc  , 50);
  lv_arc_set_value(ui_LightArc , 50);

  // Touch-driven value changes update labels and the relevant PWM output.
  lv_obj_add_event_cb(ui_VolumeArc, volume_arc_event_cb , LV_EVENT_VALUE_CHANGED, NULL);
  lv_obj_add_event_cb(ui_BulbArc  , bulb_arc_event_cb   , LV_EVENT_VALUE_CHANGED, NULL);
  lv_obj_add_event_cb(ui_LightArc , light_arc_event_cb  , LV_EVENT_VALUE_CHANGED, NULL);

  // Start the bulb demonstration output before it receives UI changes.
  ledcAttach(BULB_LED_PIN, pwmFreq, pwmResolution);
  ledcWrite(BULB_LED_PIN, 50); // Raw 8-bit duty value, approximately 20 percent.

  // Clear the NeoPixel ring before the background animation task begins.
  led.begin();
  led.setBrightness(25);  
  led.clear();
  led.show();

  delay(200);
  initBacklight();

  // Separate tasks keep LED animation and encoder polling independent of
  // the Arduino loop that services LVGL.
  xTaskCreatePinnedToCore(ledTestTask, "LED Test", 2048, NULL, 1, &ledTestTaskHandle, 0);
  xTaskCreatePinnedToCore(encTask, "ENC", 2048, NULL, 1, &encTaskHandle, 0);
}

/*---------------------------------------------------------------
 * Arduino main loop
 * Service LVGL timers while worker tasks handle LEDs and the encoder.
 *--------------------------------------------------------------*/
/**
 * @brief Run the LVGL timer and input processing cycle.
 *
 * Allows LVGL to read touch input, advance animations, dispatch events,
 * and request screen redraws, then yields briefly to other FreeRTOS tasks.
 *
 * @note Parameters: None; this is an Arduino lifecycle function.
 * @return Nothing.
 * @note Called repeatedly by the Arduino framework after setup() completes.
 */
void loop() {
  // LVGL must be serviced continuously for animation and touch response.
  lv_timer_handler();

  vTaskDelay(pdMS_TO_TICKS(5));
}
